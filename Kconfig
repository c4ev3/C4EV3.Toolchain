## Kconfig
```kconfig
#
# Kconfig: Main menu structure definition
# Copyright (C) Robert Schwebel <r.schwebel@pengutronix.de> 2005-2008
#

config _ptxconfig_MAGIC__
	bool
	default y

config BUILD_TOOLCHAIN
	bool
	default y


config PROJECT
	string
	prompt "Project Name        "
	help
	  Name of this project; each PTXdist "Project" specifies a unique
	  configuration for an embedded Linux project.

	  Usually you don't have to set this config option; change it
	  only if you want to have some non-default name.

comment "----------------------------------"

choice
	prompt "architecture      "

        config ARCH_ARM
                bool "arm    "

	config ARCH_M68K
		bool "m68k   "

	config ARCH_MIPS
		bool "mips   "

        config ARCH_POWERPC
                bool "powerpc"

	config ARCH_I386
		bool "i386   "

	config ARCH_AVR
		bool "AVR-8  "

	config ARCH_AVR32
		bool "AVR-32 "

	help
	  This option specifies the toolchain architecture. It corresponds to
	  the arch/ directory of the Linux kernel.

endchoice

config ARCH
	string
	default "arm"		if ARCH_ARM
	default "avr"		if ARCH_AVR
	default "avr32"		if ARCH_AVR32
	default "m68k"		if ARCH_M68K
	default "i386"		if ARCH_I386
	default "mips"		if ARCH_MIPS
	default "powerpc"	if ARCH_POWERPC

config GNU_TARGET
	string
	prompt "toolchain target"
	help
	  The GNU_TARGET specifies which toolchain variant is to be
	  built.

comment "----------------------------------"

source "workspace/rules/libc.in"

if LIBC_GLIBC
source "workspace/rules/glibc.in"
source "workspace/rules/glibc-ports.in"
source "workspace/rules/glibc-linuxthreads.in"
endif

if LIBC_UCLIBC
source "workspace/rules/uclibc.in"
source "workspace/rules/uclibc-headers.in"
endif

if LIBC_NEWLIB
source "workspace/rules/newlib.in"
endif

if LIBC_AVR
source "workspace/rules/avrlib.in"
endif

if LIBC_MINGW
source "workspace/rules/mingw-runtime.in"
source "workspace/rules/mingw-runtime-headers.in"
source "workspace/rules/w32api.in"
source "workspace/rules/w32api-headers.in"
endif

source "workspace/rules/cross-binutils.in"
source "workspace/rules/kernel-headers.in"
source "workspace/rules/cross-gcc.in"
source "workspace/rules/cross-gdb.in"
source "workspace/rules/cross-toolchain.in"
source "workspace/rules/host-gmp.in"
source "workspace/rules/host-mpfr.in"

comment "----------------------------------"

menu "misc                        "

config PREFIX
	string
	prompt "prefix for installation"
	default "/opt"
	help
	  Your toolchain will be installed under $PREFIX

config PREFIX_KERNEL
	string
	depends on KERNEL_HEADERS_SANITIZED
	default "-sanitized"

config PREFIX_TCID
	string	
	default "gcc-${PTXCONF_CROSS_GCC_VERSION}-glibc-${PTXCONF_GLIBC_VERSION}-binutils-${PTXCONF_CROSS_BINUTILS_VERSION}-kernel-${PTXCONF_KERNEL_HEADERS_VERSION}${PTXCONF_PREFIX_KERNEL}"	if LIBC_GLIBC
	default "gcc-${PTXCONF_CROSS_GCC_VERSION}-uclibc-${PTXCONF_UCLIBC_VERSION}-binutils-${PTXCONF_CROSS_BINUTILS_VERSION}-kernel-${PTXCONF_KERNEL_HEADERS_VERSION}${PTXCONF_PREFIX_KERNEL}"	if LIBC_UCLIBC
	default "gcc-${PTXCONF_CROSS_GCC_VERSION}-newlib-${PTXCONF_NEWLIB_VERSION}"														if LIBC_NEWLIB
	default "gcc-${PTXCONF_CROSS_GCC_VERSION}-mingw-${PTXCONF_MINGW_RUNTIME_VERSION}-w32api-${PTXCONF_W32API_VERSION}"									if LIBC_MINGW
	default "gcc-${PTXCONF_CROSS_GCC_VERSION}-libc-${PTXCONF_AVRLIB_VERSION}"														if LIBC_AVR

config SYSROOT_HOST
	string
	default "${PTXDIST_PLATFORMDIR}/sysroot-host"

config SYSROOT_CROSS
	string
	default "${PTX_AUTOBUILD_DESTDIR}${PTXCONF_PREFIX}/${PTXCONF_PROJECT}/${PTXCONF_GNU_TARGET}/${PTXCONF_PREFIX_TCID}"

config SYSROOT_TARGET
	string
	default "${PTXCONF_SYSROOT_CROSS}/sysroot-${PTXCONF_GNU_TARGET}"

config PLATFORM
	string
	default "${PTXCONF_GNU_TARGET}-${PTXCONF_PREFIX_TCID}"

config COMPILER_PREFIX
	string
	default "${PTXCONF_GNU_TARGET}-"

config TOOLCHAIN_DEBUG
	bool
	prompt "debuggable toolchain internals"
	help
	  Select this if you want to debug the glibc/libstdc++ internals.
	  Note: this enlarges your toolchain at about 500 MB.
	
config CONFIGFILE_VERSION
	string
	prompt "ptxdist version"
	default "1.99"
	help
	  Specify the PTXdist version this configuration was tested with
	  here. This is an additional sanity check to make sure that
	  only tested versions are built.

endmenu
```

## platforms/Kconfig
```kconfig
#
# platforms/Kconfig: main menu structure for platform configuration
#

mainmenu "PTXdist $PLATFORMCONFIG_VERSION"

source "generated/platform_version.in"
```
